## sdkconfig.defaults
```kconfig
# NodeBot — sdkconfig.defaults
# Freenove ESP32-S3-WROOM CAM N16R8 (16MB flash, 8MB Octal PSRAM)

# Flash
CONFIG_ESPTOOLPY_FLASHSIZE_16MB=y

# PSRAM — Octal 80 MHz
CONFIG_SPIRAM=y
CONFIG_SPIRAM_MODE_OCT=y
CONFIG_SPIRAM_SPEED_80M=y
CONFIG_SPIRAM_FETCH_INSTRUCTIONS=y
CONFIG_SPIRAM_RODATA=y

# Dual core (desabilita modo unicore explicitamente)
# CONFIG_FREERTOS_UNICORE is not set

# CPU 240 MHz
CONFIG_ESP32S3_DEFAULT_CPU_FREQ_240=y

# Console via UART0 (COM12) — GPIO43/44 usados pelo UART1 dos servos depois
CONFIG_ESP_CONSOLE_UART_DEFAULT=y

# Partition table customizada
CONFIG_PARTITION_TABLE_CUSTOM=y
CONFIG_PARTITION_TABLE_CUSTOM_FILENAME="partitions.csv"
CONFIG_PARTITION_TABLE_OFFSET=0x8000

# FAT storage partition
CONFIG_WL_SECTOR_SIZE=4096

# FAT — Long File Names (necessário para extensões > 3 chars, ex: .jsonl)
CONFIG_FATFS_LFN_HEAP=y

# Watchdog timers
# HW (interrupt) WDT: 8 s
CONFIG_ESP_INT_WDT=y
CONFIG_ESP_INT_WDT_TIMEOUT_MS=8000
# Task WDT: 3 s, panic ao expirar, não monitora idle tasks
CONFIG_ESP_TASK_WDT_EN=y
CONFIG_ESP_TASK_WDT_PANIC=y
CONFIG_ESP_TASK_WDT_TIMEOUT_S=3
CONFIG_ESP_TASK_WDT_CHECK_IDLE_TASK_CPU0=n
CONFIG_ESP_TASK_WDT_CHECK_IDLE_TASK_CPU1=n

# Suprime warning da API legada de touch (driver/touch_pad.h)
CONFIG_TOUCH_SUPPRESS_DEPRECATE_WARN=y

# mbedTLS — reduz uso de SRAM interna para TLS (HTTPS/CloudBridge/OTA)
CONFIG_MBEDTLS_DYNAMIC_BUFFER=y
CONFIG_MBEDTLS_SSL_IN_CONTENT_LEN=4096
CONFIG_MBEDTLS_SSL_OUT_CONTENT_LEN=4096

# OTA — rollback automático (E39)
# Novo firmware tem 60 s para chamar ota_manager_mark_stable() ou é revertido.
CONFIG_BOOTLOADER_APP_ROLLBACK_ENABLE=y
# Anti-rollback desabilitado (não queima efuse de versão mínima)
# CONFIG_BOOTLOADER_APP_ANTI_ROLLBACK is not set
```
